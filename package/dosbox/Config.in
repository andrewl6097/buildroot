## package/dosbox/Config.in
```kconfig
config BR2_PACKAGE_DOSBOX
    bool "dosbox"
    select BR2_PACKAGE_SDL
    select BR2_PACKAGE_SDL_SOUND
    select BR2_TOOLCHAIN_BUILDROOT_CXX
    help
        DOSBox x86 emulator.
        
        https://www.dosbox.com
```

## package/openxcom/Config.in
```kconfig
config BR2_PACKAGE_OPENXCOM
    bool "openxcom"
    select BR2_PACKAGE_SDL
    select BR2_PACKAGE_SDL_MIXER
    select BR2_PACKAGE_SDL_GFX
    select BR2_PACKAGE_SDL_IMAGE
    select BR2_PACKAGE_YAML_CPP
    help
        OpenXcom
        
        https://openxcom.org/
```
